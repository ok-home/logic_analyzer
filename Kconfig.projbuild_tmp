## Kconfig.projbuild_tmp
```kconfig
menu "Logic Analyzer Configuration"


    config LA_IN_APP_MODE
        bool "in-app mode"
        default y
        help
            In-app or separate device mode.

    config LA_USE_PORT_ASSIGN
        bool "use default port assignment"
        default y
        help
            use default port assignments for channels.
        
    if LA_USE_PORT_ASSIGN

        config LA_CHAN_0
            int "GPIO for chahhel 0"
            range -1 39
            default -1

        config LA_CHAN_1
            int "GPIO for chahhel 1"
            range -1 39
            default -1

        config LA_CHAN_2
            int "GPIO for chahhel 2"
            range -1 39
            default -1

        config LA_CHAN_3
            int "GPIO for chahhel 3"
            range -1 39
            default -1

        config LA_CHAN_4
            int "GPIO for chahhel 4"
            range -1 39
            default -1
    
        config LA_CHAN_5
            int "GPIO for chahhel 5"
            range -1 39
            default -1
    
        config LA_CHAN_6
            int "GPIO for chahhel 6"
            range -1 39
            default -1
    
        config LA_CHAN_7
            int "GPIO for chahhel 7"
            range -1 39
            default -1
                
        config LA_CHAN_8
            int "GPIO for chahhel 8"
            range -1 39
            default -1
    
        config LA_CHAN_9
            int "GPIO for chahhel 9"
            range -1 39
            default -1
    
        config LA_CHAN_10
            int "GPIO for chahhel 10"
            range -1 39
            default -1
    
        config LA_CHAN_11
            int "GPIO for chahhel 11"
            range -1 39
            default -1
    
        config LA_CHAN_12
            int "GPIO for chahhel 12"
            range -1 39
            default -1
        
        config LA_CHAN_13
            int "GPIO for chahhel 13"
            range -1 39
            default -1
        
        config LA_CHAN_14
            int "GPIO for chahhel 14"
            range -1 39
            default -1
        
        config LA_CHAN_15
            int "GPIO for chahhel 15"
            range -1 39
            default -1
    
        config LA_TRIG_PIN
            int "GPIO for trigger pin"
            range -1 39
            default -1

        config LA_TRIG_EDGE
            int "trigger edge"
            range 1 2
            default 1
            help
                trigger EDGE: 1 - POS_EDGE 2 - NEG_EDGE

        config LA_SAMPLES_COUNT
            int "Samples count"
            range 100 32764
            default 1000

        config LA_SAMPLE_RATE
            int "Sample rate HZ"
            range 5000 20000000
            default 1000000

    endif

    config LA_USE_WS
        bool "logic analyzer output data to http websocket"
        default y
        help
            logic analyzer output data to http websocket

    if LA_USE_WS

        config CREATE_WS_SERVER
            bool "create new WS server"
            default y
            help
                Create a new WS server or use an existing one.

    endif            

    config LA_USE_SUMP
            bool "Direct connect to Sizrok PulseView"
            default n
            help
                direct connect to Sigrok PulseView via sump protocol.

    if LA_USE_SUMP

        config LA_SUMP_UART_PORT_NUMBER
            int "uart port number 0-2"
            default 0
            help
                UART port number.

        config LA_SUMP_UART_PORT_BAUD_RATE
            int "uart port baud rate"
            default 921600
            help
                UART port baud rate.

        config LA_SUMP_UART_PORT_RX_PIN
            int "uart port rx pin"
            default 3
            help
                UART port port rx pin.

        config LA_SUMP_UART_PORT_TX_PIN
            int "uart port tx pin"
            default 1
            help
                UART port port tx pin.
        
    endif 


endmenu
```

## logic_analyzer_example/sdkconfig.defaults
```kconfig
CONFIG_HTTPD_WS_SUPPORT=y
CONFIG_ANALYZER_USE_WS=y
CONFIG_ESP_SYSTEM_CHECK_INT_LEVEL_4=y
CONFIG_ANALYZER_USE_HI_LEVEL_INTERRUPT=y
CONFIG_ANALYZER_START_WS_SERVER=y
```

## logic_analyzer_hal/Kconfig.projbuild
```kconfig
menu "Logic Analyzer Configuration"


    choice ANALYZER_USE_I2S_CHANNEL
        prompt "I2S Channel Number"
        default ANALYZER_USE_I2S_CHANNEL_0

        config ANALYZER_USE_I2S_CHANNEL_0
            bool "I2S0"

        config ANALYZER_USE_I2S_CHANNEL_1
            bool "I2S1"
    endchoice

    config ANALYZER_SEPARATE_MODE
        bool "Separate mode"
        default n
        help
            In-app or separate device mode.

    config ANALYZER_USE_PORT_ASSIGN
        bool "Use port assignment"
        default n
        help
            use  port assignments for channels.
        
    if ANALYZER_USE_PORT_ASSIGN

        config ANALYZER_CHAN_0
            int "GPIO for chahhel 0"
            range -1 39
            default -1

        config ANALYZER_CHAN_1
            int "GPIO for chahhel 1"
            range -1 39
            default -1

        config ANALYZER_CHAN_2
            int "GPIO for chahhel 2"
            range -1 39
            default -1

        config ANALYZER_CHAN_3
            int "GPIO for chahhel 3"
            range -1 39
            default -1

        config ANALYZER_CHAN_4
            int "GPIO for chahhel 4"
            range -1 39
            default -1
    
        config ANALYZER_CHAN_5
            int "GPIO for chahhel 5"
            range -1 39
            default -1
    
        config ANALYZER_CHAN_6
            int "GPIO for chahhel 6"
            range -1 39
            default -1
    
        config ANALYZER_CHAN_7
            int "GPIO for chahhel 7"
            range -1 39
            default -1
                
        config ANALYZER_CHAN_8
            int "GPIO for chahhel 8"
            range -1 39
            default -1
    
        config ANALYZER_CHAN_9
            int "GPIO for chahhel 9"
            range -1 39
            default -1
    
        config ANALYZER_CHAN_10
            int "GPIO for chahhel 10"
            range -1 39
            default -1
    
        config ANALYZER_CHAN_11
            int "GPIO for chahhel 11"
            range -1 39
            default -1
    
        config ANALYZER_CHAN_12
            int "GPIO for chahhel 12"
            range -1 39
            default -1
        
        config ANALYZER_CHAN_13
            int "GPIO for chahhel 13"
            range -1 39
            default -1
        
        config ANALYZER_CHAN_14
            int "GPIO for chahhel 14"
            range -1 39
            default -1
        
        config ANALYZER_CHAN_15
            int "GPIO for chahhel 15"
            range -1 39
            default -1
    
        config ANALYZER_TRIG_PIN
            int "GPIO for trigger pin"
            range -1 39
            default -1

        config ANALYZER_TRIG_EDGE
            int "trigger edge"
            range 1 2
            default 1
            help
                trigger EDGE: 1 - POS_EDGE 2 - NEG_EDGE

        config ANALYZER_SAMPLES_COUNT
            int "Samples count"
            range 100 60000
            default 1000

        config ANALYZER_SAMPLE_RATE
            int "Sample rate HZ"
            range 5000 40000000
            default 10000000

        config ANALYZER_TIMEOUT
            int "Meashured timeout Sek"
            range 2 50
            default 20
    
    endif

    config ANALYZER_USE_WS
        bool "Logic analyzer output data to http websocket"
        default y
        help
            logic analyzer output data to http websocket

    config ANALYZER_USE_SUMP
            bool "Direct connect to Sizrok PulseView"
            default n
            help
                direct connect to Sigrok PulseView via sump protocol.

    if ANALYZER_USE_SUMP

        config ANALYZER_SUMP_UART_PORT_NUMBER
            int "uart port number 0-2"
            default 0
            help
                UART port number.

        config ANALYZER_SUMP_UART_PORT_BAUD_RATE
            int "uart port baud rate"
            default 921600
            help
                UART port baud rate.

        config ANALYZER_SUMP_UART_PORT_RX_PIN
            int "uart port rx pin"
            default 3
            help
                UART port port rx pin.

        config ANALYZER_SUMP_UART_PORT_TX_PIN
            int "uart port tx pin"
            default 1
            help
                UART port port tx pin.
        
    endif 


endmenu
```
